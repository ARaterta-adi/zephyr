## tests/drivers/sensor/adxl38x/testcase.yaml
```yaml
# Copyright (c) 2026 Analog Devices Inc.
# SPDX-License-Identifier: Apache-2.0

common:
  tags:
    - drivers
    - sensor
    - adxl38x
  harness: ztest
tests:
  drivers.sensor.adxl38x:
    platform_allow:
      - native_sim
      - native_sim/native/64
```
